## sdkconfig.defaults
```kconfig
# ESP32-C6
CONFIG_IDF_TARGET="esp32c6"
CONFIG_IDF_TARGET_ESP32C6=y
CONFIG_ESPTOOLPY_FLASHSIZE_8MB=y

# Partition Table
CONFIG_PARTITION_TABLE_CUSTOM=y
CONFIG_PARTITION_TABLE_CUSTOM_FILENAME="partitions.csv"
CONFIG_PARTITION_TABLE_FILENAME="partitions.csv"
CONFIG_PARTITION_TABLE_OFFSET=0x8000
CONFIG_PARTITION_TABLE_MD5=y

# mbedTLS
CONFIG_MBEDTLS_CMAC_C=y
CONFIG_MBEDTLS_SSL_PROTO_DTLS=y
CONFIG_MBEDTLS_KEY_EXCHANGE_ECJPAKE=y
CONFIG_MBEDTLS_ECJPAKE_C=y

# OpenThread
CONFIG_OPENTHREAD_ENABLED=y
CONFIG_OPENTHREAD_BORDER_ROUTER=n
CONFIG_OPENTHREAD_DNS64_CLIENT=y
CONFIG_OPENTHREAD_NETWORK_NAME="golioth-thread"
CONFIG_OPENTHREAD_NETWORK_CHANNEL=26
CONFIG_OPENTHREAD_NETWORK_PANID=0x87B3
CONFIG_OPENTHREAD_NETWORK_MASTERKEY="ef4c40631c65d4d9c7276ec29cd366c4"

CONFIG_OPENTHREAD_JOINER=y
CONFIG_OPENTHREAD_AUTO_START=y

CONFIG_OPENTHREAD_CLI=n
CONFIG_OPENTHREAD_CLI_ESP_EXTENSION=n


CONFIG_OPENTHREAD_RADIO_NATIVE=y
CONFIG_OPENTHREAD_LOG_LEVEL_DYNAMIC=n
CONFIG_OPENTHREAD_LOG_LEVEL_WARN=y


# lwIP
CONFIG_LWIP_TCPIP_TASK_STACK_SIZE=4096
CONFIG_LWIP_IPV6_NUM_ADDRESSES=8
CONFIG_LWIP_MULTICAST_PING=y
CONFIG_LWIP_HOOK_IP6_SELECT_SRC_ADDR_CUSTOM=y

# Golioth
CONFIG_MBEDTLS_SSL_PROTO_DTLS=y
CONFIG_MBEDTLS_PSK_MODES=y
CONFIG_MBEDTLS_KEY_EXCHANGE_PSK=y
CONFIG_MBEDTLS_TLS_CLIENT_ONLY=y
CONFIG_MBEDTLS_SHA512_C=n
CONFIG_LWIP_NETBUF_RECVINFO=y
CONFIG_FREERTOS_USE_TRACE_FACILITY=y
CONFIG_FREERTOS_USE_STATS_FORMATTING_FUNCTIONS=y
CONFIG_ESP_WIFI_SOFTAP_SUPPORT=n

CONFIG_COMPILER_OPTIMIZATION_SIZE=y

# GLTH_LOGX statements will automatically upload to Golioth Logs service
CONFIG_GOLIOTH_AUTO_LOG_TO_CLOUD=y
CONFIG_GOLIOTH_COAP_REQUEST_QUEUE_MAX_ITEMS=20

# Golioth Services
CONFIG_GOLIOTH_STREAM=y
CONFIG_GOLIOTH_SETTINGS=y
CONFIG_GOLIOTH_LIGHTDB_STATE=y
CONFIG_GOLIOTH_FW_UPDATE=y
CONFIG_GOLIOTH_RPC=y
CONFIG_BOOTLOADER_APP_ROLLBACK_ENABLE=y

# Golioth libcoap
CONFIG_LIBCOAP_ENABLE_IPV6_SUPPORT=y
```
